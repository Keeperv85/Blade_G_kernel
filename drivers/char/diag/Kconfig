## drivers/char/diag/Kconfig
```kconfig
menu "Diag Support"

config DIAG_CHAR
	tristate "char driver interface and diag forwarding to/from modem"
	default m
	depends on USB_G_ANDROID || USB_FUNCTION_DIAG || USB_QCOM_MAEMO
	depends on ARCH_MSM
	help
	 Char driver interface for diag user space and diag-forwarding to modem ARM and back.
	 This enables diagchar for maemo usb gadget or android usb gadget based on config selected.
endmenu

menu "DIAG traffic over USB"

config DIAG_OVER_USB
	bool "Enable DIAG traffic to go over USB"
        depends on ARCH_MSM
	default y
	help
	 This feature helps segregate code required for DIAG traffic to go over USB.
endmenu

menu "SDIO support for DIAG"

config DIAG_SDIO_PIPE
	depends on MSM_SDIO_AL
	default y
	bool "Enable 9K DIAG traffic over SDIO"
	help
	 SDIO Transport Layer for DIAG Router
endmenu

menu "HSIC support for DIAG"

config DIAG_BRIDGE_CODE
	depends on USB_QCOM_DIAG_BRIDGE
	default y
	bool "Enable QSC/9K DIAG traffic over SMUX/HSIC"
	help
	 SMUX/HSIC Transport Layer for DIAG Router
endmenu

#zte chenjg add for diag lock/unlock begin

menu "Lock diag command"

config ZTE_FEATURE_DIAG_LOCK_ENABLE
	default n
	bool "Enable to lock diag command"
	help
	 Enable to lock diag command
endmenu

#zte chenjg add for diag lock/unlock end
```
